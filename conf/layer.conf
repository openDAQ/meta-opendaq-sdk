## conf/layer.conf
```bitbake
# We have a conf and classes directory, add to BBPATH
BBPATH .= ":${LAYERDIR}"

# We have recipes-* directories, add to BBFILES
BBFILES += "${LAYERDIR}/recipes-*/*/*.bb ${LAYERDIR}/recipes-*/*/*.bbappend"

BBFILE_COLLECTIONS += "opendaq-sdk"
BBFILE_PATTERN_opendaq-sdk = "^${LAYERDIR}/"
BBFILE_PRIORITY_opendaq-sdk = "10"

# This should only be incremented on significant changes that will
# cause compatibility issues with other layers
LAYERVERSION_opendaq-sdk = "1"

LAYERDEPENDS_opendaq-sdk = "core"

LAYERSERIES_COMPAT_opendaq-sdk = "dunfell"
```
